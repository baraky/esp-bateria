## main/Kconfig.projbuild
```kconfig
menu "Configuração do Wifi Configuration"

    config ESP_WIFI_SSID
        string "WiFi SSID"
        default "GALAXIA 2G"
        help
            Nome da rede Wifi.

    config ESP_WIFI_PASSWORD
        string "Senha do Wifi"
        default "jupiterrs"
        help
            Senha do WiFi (WPA or WPA2).

    config ESP_MAXIMUM_RETRY
        int "Número máximo de tentativas de conexão"
        default 5
        help
            Configure o valor máximo de tentativas de conexão.
endmenu
```
